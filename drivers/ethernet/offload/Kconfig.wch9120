## drivers/ethernet/offload/Kconfig.wch9120
```kconfig
# Copyright (c) 2026 Madhab Sharma <madhabsharma94@gmail.com>
# SPDX-License-Identifier: Apache-2.0
# CH9120 ethernet driver options

menuconfig ETH_CH9120
	bool "ch9120 ethernet driver"
	depends on DT_HAS_WCH_CH9120_ENABLED
	depends on UART_INTERRUPT_DRIVEN
	select NET_SOCKETS_OFFLOAD
	select UART_USE_RUNTIME_CONFIGURE
	help
	  This offloads ethernet driver to ch9120 chip. Note: the
	  chip only supports only a single TCP/UDP client connection at
	  a time. Attempting to open a second socket will fail.

if ETH_CH9120

config ETH_CH9120_RX_BUF_SIZE
	int "RX ring buffer size in bytes"
	default 1024
	range 256 4096
	help
	  Size of the receive ring buffer. Increase if dropping
	  data at high throughput.

choice
	prompt "Serial Baudrate"
	default ETH_CH9120_BAUDRATE_9600
	help
	  Select the desired baudrate for the serial communication.

config ETH_CH9120_BAUDRATE_300
	bool "300"
config ETH_CH9120_BAUDRATE_600
	bool "600"
config ETH_CH9120_BAUDRATE_1200
	bool "1200"
config ETH_CH9120_BAUDRATE_2400
	bool "2400"
config ETH_CH9120_BAUDRATE_4800
	bool "4800"
config ETH_CH9120_BAUDRATE_9600
	bool "9600"
config ETH_CH9120_BAUDRATE_14400
	bool "14400"
config ETH_CH9120_BAUDRATE_19200
	bool "19200"
config ETH_CH9120_BAUDRATE_38400
	bool "38400"
config ETH_CH9120_BAUDRATE_57600
	bool "57600"
config ETH_CH9120_BAUDRATE_115200
	bool "115200"
config ETH_CH9120_BAUDRATE_230400
	bool "230400"
config ETH_CH9120_BAUDRATE_460800
	bool "460800"
config ETH_CH9120_BAUDRATE_921600
	bool "921600"
endchoice

config ETH_CH9120_BAUDRATE
	int
	default 300 if ETH_CH9120_BAUDRATE_300
	default 600 if ETH_CH9120_BAUDRATE_600
	default 1200 if ETH_CH9120_BAUDRATE_1200
	default 2400 if ETH_CH9120_BAUDRATE_2400
	default 4800 if ETH_CH9120_BAUDRATE_4800
	default 9600 if ETH_CH9120_BAUDRATE_9600
	default 14400 if ETH_CH9120_BAUDRATE_14400
	default 19200 if ETH_CH9120_BAUDRATE_19200
	default 38400 if ETH_CH9120_BAUDRATE_38400
	default 57600 if ETH_CH9120_BAUDRATE_57600
	default 115200 if ETH_CH9120_BAUDRATE_115200
	default 230400 if ETH_CH9120_BAUDRATE_230400
	default 460800 if ETH_CH9120_BAUDRATE_460800
	default 921600 if ETH_CH9120_BAUDRATE_921600

endif # ETH_CH9120
```

## drivers/ethernet/pico_uart_eth/Kconfig
```kconfig
# CH9120 ethernet driver options

# SPDX-License-Identifier: Apache-2.0

menuconfig ETH_CH9120
	bool "ch9120 ethernet driver"
	depends on DT_HAS_WCH_CH9120_ENABLED
	depends on UART_INTERRUPT_DRIVEN
	select NET_SOCKETS_OFFLOAD
	help
	  This offloads ethernet driver to ch9120 chip

if ETH_CH9120

config ETH_CH9120_RX_BUF_SIZE
	int "RX ring buffer size in bytes"
	default 1024
	range 256 4096
	help
	  Size of the receive ring buffer. Increase if dropping
	  data at high throughput.

config ETH_CH9120_MODE_TCP_CLIENT
	bool "Enable TCP client mode"
	default y
	help
	  Enable TCP client operating mode for the CH9120 chip.

endif # ETH_CH9120
```

## drivers/ethernet/pico_uart_eth/Kconfig.ch9120
```kconfig
# CH9120 ethernet driver options

# SPDX-License-Identifier: Apache-2.0

menuconfig ETH_CH9120
	bool "ch9120 ethernet driver"
	depends on UART_INTERRUPT_DRIVEN
	select NET_OFFLOAD
	help
	  This offloads ethernet driver to ch9120 chip

if ETH_CH9120

endif # ETH_CH9120
```

## samples/drivers/ethernet/ch9120/testcase.yaml
```yaml
tests:
  drivers.ethernet.ch9120.init:
    tags:
      - drivers
      - ethernet
    platform_allow:
      - rpi_pico2/rp2350a/m33
    build_only: true
```

## tests/drivers/ethernet/ch9120/testcase.yaml
```yaml
tests:
  drivers.ethernet.ch9120.init:
    tags:
      - drivers
      - ethernet
      - net
    platform_allow:
      - rpi_pico2          # only run on this board
    harness: ztest
    harness_config:
      fixture: ch9120_connected   # tells CI this needs physical hardware wired up
    timeout: 60

  drivers.ethernet.ch9120.socket:
    tags:
      - drivers
      - ethernet
      - net
    platform_allow:
      - rpi_pico2
    harness: ztest
    harness_config:
      fixture: ch9120_network     # needs network connectivity too
    timeout: 120
```
